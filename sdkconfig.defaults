## sdkconfig.defaults
```kconfig
# Flash size
CONFIG_ESPTOOLPY_FLASHSIZE_4MB=y
CONFIG_ESPTOOLPY_FLASHSIZE="4MB"

# Partition table
CONFIG_PARTITION_TABLE_CUSTOM=y
CONFIG_PARTITION_TABLE_CUSTOM_FILENAME="partitions.csv"

# Compiler optimization
CONFIG_COMPILER_OPTIMIZATION_DEBUG=y

# Log level
CONFIG_LOG_DEFAULT_LEVEL_INFO=y
CONFIG_LOG_DEFAULT_LEVEL=3

# Task WDT timeout
CONFIG_ESP_TASK_WDT_TIMEOUT_S=30

# Interrupt WDT - disabled for Wokwi compatibility
CONFIG_INT_WDT=n
```
